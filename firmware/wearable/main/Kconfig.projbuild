## firmware/wearable/main/Kconfig.projbuild
```kconfig
menu "MedMusketeer Wearable"

choice WEARABLE_MODE
    prompt "Path mode (compile-time selection)"
    default WEARABLE_MODE_FIXED

config WEARABLE_MODE_FIXED
    bool "Fixed path (local gateway)"

config WEARABLE_MODE_MOBILE
    bool "Mobile mode (placeholder)"

endchoice

config WEARABLE_OLED_SDA_GPIO
    int "SH1106 I2C SDA GPIO"
    range 0 48
    default 9

config WEARABLE_OLED_SCL_GPIO
    int "SH1106 I2C SCL GPIO"
    range 0 48
    default 3

config WEARABLE_OLED_I2C_ADDRESS
    hex "SH1106 I2C address"
    range 0x3C 0x3D
    default 0x3C

config WEARABLE_ALERT_BUTTON_GPIO
    int "Alert push button GPIO (active low, internal pull-up)"
    range 0 48
    default 21
    help
        A press publishes one alert with a synthetic ECG segment. It stands in for the on-device
        model until Iteration 5.

config WEARABLE_ECG_OUTPUT_GPIO
    int "AD8232 OUTPUT GPIO (ADC1: GPIO 1-10)"
    range 1 10
    default 2
    help
        Analog ECG signal. Must be an ADC1 pin, because ADC2 is shared with Wi-Fi.
        The firmware does not sample the AD8232 until Iteration 5.

config WEARABLE_ECG_LO_PLUS_GPIO
    int "AD8232 LO+ (leads-off detect) GPIO"
    range 0 48
    default 15

config WEARABLE_ECG_LO_MINUS_GPIO
    int "AD8232 LO- (leads-off detect) GPIO"
    range 0 48
    default 38

config WEARABLE_ECG_SDN_GPIO
    int "AD8232 SDN (shutdown, active low) GPIO"
    range 0 48
    default 5

endmenu
```

## firmware/wearable/sdkconfig.defaults
```kconfig
CONFIG_IDF_TARGET="esp32s3"
CONFIG_PARTITION_TABLE_CUSTOM=y
CONFIG_PARTITION_TABLE_CUSTOM_FILENAME="partitions.csv"
CONFIG_BT_ENABLED=y
CONFIG_BT_NIMBLE_ENABLED=y
CONFIG_BT_NIMBLE_NVS_PERSIST=y
CONFIG_BT_NIMBLE_ATT_PREFERRED_MTU=517
CONFIG_LWIP_SNTP_MAX_SERVERS=3
```
